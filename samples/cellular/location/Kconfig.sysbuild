## samples/cellular/location/Kconfig.sysbuild
```kconfig
#
# Copyright (c) 2024 Nordic Semiconductor
#
# SPDX-License-Identifier: LicenseRef-Nordic-5-Clause
#

config WIFI_NRF70
	default n

source "share/sysbuild/Kconfig"
```
