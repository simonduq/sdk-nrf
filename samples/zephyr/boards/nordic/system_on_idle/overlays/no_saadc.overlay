/*
 * Single-variable isolation: disable SAADC only. The nrf7120dk board dts
 * enables &adc unconditionally (nrf7120_cpuapp_common.dtsi), regardless of
 * whether the application uses it. SAADC.PCRMREQ is a documented request bit
 * asking PCRM for "clean power" (internal datasheet, HVBUCK state diagram
 * Figure 34: "clean power request from PCRM" forces the mode state machine
 * back toward HP). This overlay tests whether disabling SAADC removes that
 * request and lets the HP<->LP bounce (EVENTS_HP2LP/EVENTS_LP2HP firing every
 * idle cycle) stop.
 */

&adc {
	status = "disabled";
};
