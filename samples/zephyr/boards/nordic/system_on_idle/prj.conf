## CMakeLists.txt
```
# SPDX-License-Identifier: LicenseRef-Nordic-5-Clause

cmake_minimum_required(VERSION 3.20.0)

find_package(Zephyr REQUIRED HINTS $ENV{ZEPHYR_BASE})
project(nrf7120_system_on_idle)

target_sources(app PRIVATE src/main.c)
```

## Kconfig
```
mainmenu "nRF7120 System ON idle measurement"

config NRF7120_IDLE_DIAGNOSTICS
	bool "Print System ON idle register snapshots"
	depends on SOC_NRF7120 && SERIAL
	help
	  Print POWER, REGULATORS, HVBUCK, MEMCONF, GRTC, oscillator, and
	  top-level CLOCK state before and after each timed idle interval.
	  These snapshots are taken while the CPU and UART are active; they
	  describe persistent configuration and events, not instantaneous
	  register values during WFI.

config NRF7120_HVBUCK_EVENT_CLEAR
	bool "Clear HVBUCK mode-change events before each idle window"
	depends on NRF7120_IDLE_DIAGNOSTICS
	help
	  Write zero to HVBUCK EVENTS_LP2HP, EVENTS_HP2LP, EVENTS_HP2PWM, and
	  EVENTS_PWM2HP before each timed idle window, then print the
	  immediate post-clear readback. This is the only write this sample
	  makes to the buck converter's own peripheral state, so it is
	  opt-in and default-off: building and flashing the diagnostics
	  variant without this option enabled never writes to HVBUCK.
	  Enabling it is what revealed that EVENTS_HP2LP and EVENTS_LP2HP
	  both fire on every single idle cycle, proving a real HP->LP->HP
	  transition attempt that STATUS and an oscilloscope are both too
	  slow to catch directly.

config NRF7120_FORCE_LOWPWR
	bool "Request variable-latency low-power mode"
	depends on SOC_NRF7120
	help
	  Trigger POWER.TASKS_LOWPWR before entering timed or permanent idle.
	  In this mode oscillators and regulators may stop when no remaining
	  consumer requests their clock or power resources. Hardware A/B
	  testing found no measurable difference with or without this
	  option; it is kept because it is a real, one-shot hardware
	  request worth trying, not because it is known to matter.

config NRF7120_PDSELECT_DIAGNOSTICS
	bool "Route one internal power-state signal to P0.10"
	depends on SOC_NRF7120
	help
	  Write SREGS30.PDSELECT.PIN1 to route the selected internal signal to
	  P0.10. PIN0/P0.09 is kept disabled because P0.09 supplies the board
	  Wi-Fi antenna switch and was not usable as a general monitor.

config NRF7120_PDSELECT_SIGNAL
	int "P0.10 PDSELECT signal"
	depends on NRF7120_PDSELECT_DIAGNOSTICS
	range 0 13
	default 4
	help
	  Select the signal routed through PDSELECT.PIN1 to P0.10:
	  0 disabled, 1 PD_MAIN, 2 PD_LP, 3 PD_PERIPH, 4 PD_MCU,
	  5 PD_RADIO, 6 PD_CRACEN/PD_MCU_AUX, 7 PD_WIFI,
	  8 PwrAboveElv, 9 HVBUCK 1.1 V acknowledge,
	  10 HVBUCK 1.0 V acknowledge, 11 HVBUCK LP mode,
	  12 HVBUCK PWM mode, 13 helper-LDO acknowledge.

config NRF7120_IDLE_PHASE_MARKER
	bool "Track System ON run/idle on P0.00"
	depends on SOC_NRF7120 && SERIAL && GPIO
	help
	  Drive P0.00 high whenever the CPU is not idling (from just after
	  main() starts, and again immediately after every k_sleep/WFI
	  returns) and low, then disconnected, immediately before every
	  k_sleep/WFI call. This directly tracks System ON run versus System
	  ON idle and WFI entry/exit; the pin is disconnected while idling so
	  an active GPIO output cannot itself hold a power domain on. Because
	  it goes high right at the start of the timed loop, a rising edge
	  shortly after power-up also proves the application booted.

config NRF7120_SLEEP_FOREVER
	bool "Block the main thread forever"
	depends on SOC_NRF7120 && !SERIAL
	help
	  Call k_sleep(K_FOREVER) after all requested configuration. This
	  retains the normal Zephyr scheduler and idle-thread path but adds no
	  periodic application timeout. Use for quiet, stable current
	  measurements (combine with configs/quiet.conf).

config NRF7120_WIFI_AUTOCGCORE_CLEAR
	bool "Apply the WZN-9779 Wi-Fi clock workaround"
	depends on SOC_NRF7120
	help
	  Clear WIFICORECLOCKRESETCTRL.CLOCKGATECTRLAUTOCG1.AUTOCGCORE before
	  idle. WZN-9779 identifies this bit as a source of a prolonged Wi-Fi
	  core-clock request after debugger disconnect. This is an engineering
	  diagnostic workaround, not a production integration decision.

source "Kconfig.zephyr"
```

## sample.yaml
```
sample:
  name: nRF7120 System ON idle diagnostics

common:
  build_only: true
  platform_allow:
    - nrf7120dk/nrf7120/cpuapp
  integration_platforms:
    - nrf7120dk/nrf7120/cpuapp
  tags:
    - ci_samples_zephyr_boards_nordic_system_on_idle

tests:
  nrf.extended.sample.boards.nrf.system_on_idle.diagnostics:
    extra_args:
      - EXTRA_CONF_FILE="configs/ram_128k.conf;configs/diagnostics.conf;configs/force_lowpwr.conf"

  nrf.extended.sample.boards.nrf.system_on_idle.domain_marker_pdmcu:
    extra_args:
      - EXTRA_CONF_FILE="configs/ram_128k.conf;configs/diagnostics.conf;configs/force_lowpwr.conf;configs/wifi_autocgcore_clear.conf;configs/pd_mcu.conf;configs/idle_phase_marker.conf"

  nrf.extended.sample.boards.nrf.system_on_idle.hvbuck_event_clear:
    extra_args:
      - EXTRA_CONF_FILE="configs/ram_128k.conf;configs/diagnostics.conf;configs/force_lowpwr.conf;configs/wifi_autocgcore_clear.conf;configs/pd_mcu.conf;configs/idle_phase_marker.conf;configs/hvbuck_event_clear.conf"

  nrf.extended.sample.boards.nrf.system_on_idle.quiet_pdmcu:
    extra_args:
      - EXTRA_CONF_FILE="configs/quiet.conf;configs/ram_128k.conf;configs/force_lowpwr.conf;configs/sleep_forever.conf;configs/sloppy_idle.conf;configs/wifi_autocgcore_clear.conf;configs/pd_mcu.conf"
```

## prj.conf
```kconfig
CONFIG_PM_DEVICE=y
CONFIG_SERIAL=y
CONFIG_CONSOLE=y
CONFIG_UART_CONSOLE=y
CONFIG_PRINTK=y
CONFIG_TICKLESS_KERNEL=y
```

## src/main.c
```c
/*
 * Copyright (c) 2026 Nordic Semiconductor ASA
 *
 * SPDX-License-Identifier: LicenseRef-Nordic-5-Clause
 */

#include <zephyr/device.h>
#include <zephyr/devicetree.h>
#include <zephyr/drivers/timer/system_timer.h>
#include <zephyr/kernel.h>
#include <zephyr/pm/device.h>

#include <hal/nrf_gpio.h>
#include <hal/nrf_power.h>

#if defined(CONFIG_RAM_POWER_DOWN_LIBRARY)
#include <ram_pwrdn.h>
#endif

#if !defined(CONFIG_SOC_NRF7120)
#error "This diagnostic sample supports nRF7120 only"
#endif

#define IDLE_TIME	 K_SECONDS(5)
#define ACTIVE_TIME_US	 5000000U
#define POWERED_RAM_SIZE (128U * 1024U)

/*
 * Internal nRF7120 ENGA registers not exposed by the public HAL.
 * See README.rst for the MDK and internal-datasheet source of each address.
 */
#define NRF7120_REGULATORS_BASE		    ((uintptr_t)NRF_REGULATORS)
#define NRF7120_REGULATORS_DCDCEN_ADDR	    (NRF7120_REGULATORS_BASE + 0x540U)
#define NRF7120_REGULATORS_ENABLE_ADDR	    (NRF7120_REGULATORS_BASE + 0x544U)
#define NRF7120_REGULATORS_CONFIG_ADDR	    (NRF7120_REGULATORS_BASE + 0x548U)
#define NRF7120_REGULATORS_ELVCONFIG_ADDR   (NRF7120_REGULATORS_BASE + 0x550U)
#define NRF7120_REGULATORS_PORBORRESET_ADDR (NRF7120_REGULATORS_BASE + 0x584U)
#define NRF7120_REGULATORS_A2A_ADDR	    (NRF7120_REGULATORS_BASE + 0x588U)
#define NRF7120_REGULATORS_ROM_ADDR	    (NRF7120_REGULATORS_BASE + 0x58CU)

#define NRF7120_CLOCK_BASE		    ((uintptr_t)NRF_CLOCK)
#define NRF7120_CLOCK_XO_SRC_ADDR	    (NRF7120_CLOCK_BASE + 0x400U)
#define NRF7120_CLOCK_XO_ALWAYSRUN_ADDR	    (NRF7120_CLOCK_BASE + 0x404U)
#define NRF7120_CLOCK_XO_RUN_ADDR	    (NRF7120_CLOCK_BASE + 0x408U)
#define NRF7120_CLOCK_XO_STAT_ADDR	    (NRF7120_CLOCK_BASE + 0x40CU)
#define NRF7120_CLOCK_PLL_SRC_ADDR	    (NRF7120_CLOCK_BASE + 0x420U)
#define NRF7120_CLOCK_PLL_ALWAYSRUN_ADDR    (NRF7120_CLOCK_BASE + 0x424U)
#define NRF7120_CLOCK_PLL_RUN_ADDR	    (NRF7120_CLOCK_BASE + 0x428U)
#define NRF7120_CLOCK_PLL_STAT_ADDR	    (NRF7120_CLOCK_BASE + 0x42CU)
#define NRF7120_CLOCK_LFCLK_SRC_ADDR	    (NRF7120_CLOCK_BASE + 0x440U)
#define NRF7120_CLOCK_LFCLK_ALWAYSRUN_ADDR  (NRF7120_CLOCK_BASE + 0x444U)
#define NRF7120_CLOCK_LFCLK_RUN_ADDR	    (NRF7120_CLOCK_BASE + 0x448U)
#define NRF7120_CLOCK_LFCLK_STAT_ADDR	    (NRF7120_CLOCK_BASE + 0x44CU)
#define NRF7120_CLOCK_LFCLK_SRCCOPY_ADDR    (NRF7120_CLOCK_BASE + 0x450U)
#define NRF7120_CLOCK_PLL24M_SRC_ADDR	    (NRF7120_CLOCK_BASE + 0x460U)
#define NRF7120_CLOCK_PLL24M_ALWAYSRUN_ADDR (NRF7120_CLOCK_BASE + 0x464U)
#define NRF7120_CLOCK_PLL24M_RUN_ADDR	    (NRF7120_CLOCK_BASE + 0x468U)
#define NRF7120_CLOCK_PLL24M_STAT_ADDR	    (NRF7120_CLOCK_BASE + 0x46CU)
#define NRF7120_CLOCK_AUXPLL_SRC_ADDR	    (NRF7120_CLOCK_BASE + 0x480U)
#define NRF7120_CLOCK_AUXPLL_ALWAYSRUN_ADDR (NRF7120_CLOCK_BASE + 0x484U)
#define NRF7120_CLOCK_AUXPLL_RUN_ADDR	    (NRF7120_CLOCK_BASE + 0x488U)
#define NRF7120_CLOCK_AUXPLL_STAT_ADDR	    (NRF7120_CLOCK_BASE + 0x48CU)

#define NRF7120_HVBUCK_BASE		0x5012D000UL
#define NRF7120_HVBUCK_EVENTS_LP2HP_ADDR   (NRF7120_HVBUCK_BASE + 0x108U)
#define NRF7120_HVBUCK_EVENTS_HP2LP_ADDR   (NRF7120_HVBUCK_BASE + 0x10CU)
#define NRF7120_HVBUCK_EVENTS_HP2PWM_ADDR  (NRF7120_HVBUCK_BASE + 0x110U)
#define NRF7120_HVBUCK_EVENTS_PWM2HP_ADDR  (NRF7120_HVBUCK_BASE + 0x114U)
#define NRF7120_HVBUCK_STATUS_ADDR	(NRF7120_HVBUCK_BASE + 0x400U)
#define NRF7120_HVBUCK_STATUSANA_ADDR      (NRF7120_HVBUCK_BASE + 0x404U)
#define NRF7120_HVBUCK_FSMSTATEMMI_ADDR    (NRF7120_HVBUCK_BASE + 0x408U)
#define NRF7120_HVBUCK_VOUT0V65_ADDR	(NRF7120_HVBUCK_BASE + 0x40CU)
#define NRF7120_HVBUCK_VOUT0V8LP_ADDR	(NRF7120_HVBUCK_BASE + 0x410U)
#define NRF7120_HVBUCK_VOUT0V8HP_ADDR	(NRF7120_HVBUCK_BASE + 0x414U)
#define NRF7120_HVBUCK_VOUTUPSCALE_ADDR (NRF7120_HVBUCK_BASE + 0x418U)
#define NRF7120_HVBUCK_ITHRESHOLD_ADDR     (NRF7120_HVBUCK_BASE + 0x428U)
#define NRF7120_HVBUCK_IHYSTERESIS_ADDR    (NRF7120_HVBUCK_BASE + 0x42CU)
#define NRF7120_HVBUCK_MODECTRL_ADDR	(NRF7120_HVBUCK_BASE + 0x434U)
#define NRF7120_HVBUCK_VOLTAGECTRL_ADDR (NRF7120_HVBUCK_BASE + 0x438U)
#define NRF7120_HVBUCK_SWREADY_ADDR	(NRF7120_HVBUCK_BASE + 0x450U)
#define NRF7120_HVBUCK_CONFIG_CFGC_ADDR    (NRF7120_HVBUCK_BASE + 0x800U)
#define NRF7120_HVBUCK_CONFIG_CFG1_ADDR    (NRF7120_HVBUCK_BASE + 0x804U)

#define NRF7120_SAADC_BASE		0x500D5000UL
#define NRF7120_SAADC_PCRMSTATUS_ADDR	(NRF7120_SAADC_BASE + 0x404U)
#define NRF7120_SAADC_PCRMREQ_ADDR	(NRF7120_SAADC_BASE + 0x5FCU)

#define NRF7120_SREGS30_BASE	      0x5010F000UL
#define NRF7120_SREGS30_PDSELECT_ADDR (NRF7120_SREGS30_BASE + 0x780U)

#define NRF7120_WIFI_RPUPBUS_BASE		 0x48080000UL
#define NRF7120_WIFI_CLOCKRESETCTRL_OFFSET	 0x1B000UL
#define NRF7120_WIFI_CLOCKGATECTRLAUTOCG1_OFFSET 0x160UL
#define NRF7120_WIFI_CLOCKGATECTRLAUTOCG1_ADDR                                                     \
	(NRF7120_WIFI_RPUPBUS_BASE + NRF7120_WIFI_CLOCKRESETCTRL_OFFSET +                          \
	 NRF7120_WIFI_CLOCKGATECTRLAUTOCG1_OFFSET)
#define NRF7120_WIFI_AUTOCGCORE_MASK (1UL << 28)

#define NRF7120_REGULATORS_ROMDONE_ADDR 0x5012058CUL

#if defined(CONFIG_NRF7120_IDLE_DIAGNOSTICS)
static uint32_t reg_read32(uintptr_t address)
{
	return *(volatile uint32_t *)address;
}

static void reg_write32(uintptr_t address, uint32_t value)
{
	*(volatile uint32_t *)address = value;
}

static void print_power_snapshot(const char *phase)
{
	printk("%s: CONSTLATSTAT=0x%08x ELVCONFIG=0x%08x "
	       "HV_STATUS=0x%08x HV_MODECTRL=0x%08x "
	       "HV_VOLTAGECTRL=0x%08x HV_SWREADY=0x%08x\n",
	       phase, NRF_POWER->CONSTLATSTAT, reg_read32(NRF7120_REGULATORS_ELVCONFIG_ADDR),
	       reg_read32(NRF7120_HVBUCK_STATUS_ADDR), reg_read32(NRF7120_HVBUCK_MODECTRL_ADDR),
	       reg_read32(NRF7120_HVBUCK_VOLTAGECTRL_ADDR),
	       reg_read32(NRF7120_HVBUCK_SWREADY_ADDR));

	printk("%s: MEMCONF0 CONTROL=0x%08x RET=0x%08x RET2=0x%08x "
	       "MEMCONF1 CONTROL=0x%08x RET=0x%08x RET2=0x%08x\n",
	       phase, NRF_MEMCONF->POWER[0].CONTROL, NRF_MEMCONF->POWER[0].RET,
	       NRF_MEMCONF->POWER[0].RET2, NRF_MEMCONF->POWER[1].CONTROL, NRF_MEMCONF->POWER[1].RET,
	       NRF_MEMCONF->POWER[1].RET2);

	printk("%s: GRTC_MODE=0x%08x GRTC_SYSCOUNTER0_ACTIVE=0x%08x "
	       "LFXO_STATUS=0x%08x LFXO_MODE=0x%08x\n",
	       phase, NRF_GRTC->MODE, NRF_GRTC->SYSCOUNTER[0].ACTIVE, NRF_LFXO->STATUS,
	       NRF_LFXO->MODE);

	printk("%s: REG_DCDCEN=0x%08x REG_ENABLE=0x%08x "
	       "REG_CONFIG=0x%08x PORBORRESET=0x%08x "
	       "A2A=0x%08x ROM=0x%08x\n",
	       phase, reg_read32(NRF7120_REGULATORS_DCDCEN_ADDR),
	       reg_read32(NRF7120_REGULATORS_ENABLE_ADDR),
	       reg_read32(NRF7120_REGULATORS_CONFIG_ADDR),
	       reg_read32(NRF7120_REGULATORS_PORBORRESET_ADDR),
	       reg_read32(NRF7120_REGULATORS_A2A_ADDR), reg_read32(NRF7120_REGULATORS_ROM_ADDR));

	printk("%s: CLK_XO SRC=0x%08x ALWAYS=0x%08x RUN=0x%08x STAT=0x%08x "
	       "PLL SRC=0x%08x ALWAYS=0x%08x RUN=0x%08x STAT=0x%08x\n",
	       phase, reg_read32(NRF7120_CLOCK_XO_SRC_ADDR),
	       reg_read32(NRF7120_CLOCK_XO_ALWAYSRUN_ADDR), reg_read32(NRF7120_CLOCK_XO_RUN_ADDR),
	       reg_read32(NRF7120_CLOCK_XO_STAT_ADDR), reg_read32(NRF7120_CLOCK_PLL_SRC_ADDR),
	       reg_read32(NRF7120_CLOCK_PLL_ALWAYSRUN_ADDR), reg_read32(NRF7120_CLOCK_PLL_RUN_ADDR),
	       reg_read32(NRF7120_CLOCK_PLL_STAT_ADDR));

	printk("%s: CLK_LF SRC=0x%08x ALWAYS=0x%08x RUN=0x%08x "
	       "STAT=0x%08x COPY=0x%08x PLL24 SRC=0x%08x ALWAYS=0x%08x "
	       "RUN=0x%08x STAT=0x%08x\n",
	       phase, reg_read32(NRF7120_CLOCK_LFCLK_SRC_ADDR),
	       reg_read32(NRF7120_CLOCK_LFCLK_ALWAYSRUN_ADDR),
	       reg_read32(NRF7120_CLOCK_LFCLK_RUN_ADDR), reg_read32(NRF7120_CLOCK_LFCLK_STAT_ADDR),
	       reg_read32(NRF7120_CLOCK_LFCLK_SRCCOPY_ADDR),
	       reg_read32(NRF7120_CLOCK_PLL24M_SRC_ADDR),
	       reg_read32(NRF7120_CLOCK_PLL24M_ALWAYSRUN_ADDR),
	       reg_read32(NRF7120_CLOCK_PLL24M_RUN_ADDR),
	       reg_read32(NRF7120_CLOCK_PLL24M_STAT_ADDR));

	printk("%s: CLK_AUX SRC=0x%08x ALWAYS=0x%08x RUN=0x%08x STAT=0x%08x\n", phase,
	       reg_read32(NRF7120_CLOCK_AUXPLL_SRC_ADDR),
	       reg_read32(NRF7120_CLOCK_AUXPLL_ALWAYSRUN_ADDR),
	       reg_read32(NRF7120_CLOCK_AUXPLL_RUN_ADDR),
	       reg_read32(NRF7120_CLOCK_AUXPLL_STAT_ADDR));

	uint32_t modectrl = reg_read32(NRF7120_HVBUCK_MODECTRL_ADDR);

	printk("%s: HV_VOUT0V65=0x%08x HV_VOUT0V8LP=0x%08x "
	       "HV_VOUT0V8HP=0x%08x HV_VOUTUPSCALE=0x%08x\n",
	       phase, reg_read32(NRF7120_HVBUCK_VOUT0V65_ADDR),
	       reg_read32(NRF7120_HVBUCK_VOUT0V8LP_ADDR),
	       reg_read32(NRF7120_HVBUCK_VOUT0V8HP_ADDR),
	       reg_read32(NRF7120_HVBUCK_VOUTUPSCALE_ADDR));
	printk("%s: HV_MODECTRL_VAL=%u BLOCK_MODE_LP=%u BLOCK_MODE_ULV=%u "
	       "BLOCK_MODE_PWM=%u (raw=0x%08x)\n",
	       phase, modectrl & 0x3U, (modectrl >> 8) & 0x1U, (modectrl >> 9) & 0x1U,
	       (modectrl >> 10) & 0x1U, modectrl);

	printk("%s: HV_STATUSANA=0x%08x HV_FSMSTATEMMI=0x%08x "
	       "HV_CFGC=0x%08x HV_CFG1=0x%08x\n",
	       phase, reg_read32(NRF7120_HVBUCK_STATUSANA_ADDR),
	       reg_read32(NRF7120_HVBUCK_FSMSTATEMMI_ADDR),
	       reg_read32(NRF7120_HVBUCK_CONFIG_CFGC_ADDR),
	       reg_read32(NRF7120_HVBUCK_CONFIG_CFG1_ADDR));
	printk("%s: HV_ITHRESHOLD=0x%08x HV_IHYSTERESIS=0x%08x "
	       "HV_EVT_LP2HP=%u HV_EVT_HP2LP=%u "
	       "HV_EVT_HP2PWM=%u HV_EVT_PWM2HP=%u\n",
	       phase, reg_read32(NRF7120_HVBUCK_ITHRESHOLD_ADDR),
	       reg_read32(NRF7120_HVBUCK_IHYSTERESIS_ADDR),
	       reg_read32(NRF7120_HVBUCK_EVENTS_LP2HP_ADDR),
	       reg_read32(NRF7120_HVBUCK_EVENTS_HP2LP_ADDR),
	       reg_read32(NRF7120_HVBUCK_EVENTS_HP2PWM_ADDR),
	       reg_read32(NRF7120_HVBUCK_EVENTS_PWM2HP_ADDR));

	printk("%s: SAADC_PCRMREQ=0x%08x SAADC_PCRMSTATUS=0x%08x\n", phase,
	       reg_read32(NRF7120_SAADC_PCRMREQ_ADDR),
	       reg_read32(NRF7120_SAADC_PCRMSTATUS_ADDR));
}
#endif

#if defined(CONFIG_NRF7120_PDSELECT_DIAGNOSTICS)
static void configure_pdselect(void)
{
	volatile uint32_t *const pdselect = (volatile uint32_t *)NRF7120_SREGS30_PDSELECT_ADDR;

	/* PIN0/P0.09 is disabled. PIN1/P0.10 carries the selected signal. */
	*pdselect = (CONFIG_NRF7120_PDSELECT_SIGNAL & 0xFU) << 4;
	__DSB();

#if defined(CONFIG_SERIAL)
	printk("PDSELECT enabled: P0.10 selector=%d register=0x%08x\n",
	       CONFIG_NRF7120_PDSELECT_SIGNAL, *pdselect);
#endif
}
#endif

#if defined(CONFIG_NRF7120_WIFI_AUTOCGCORE_CLEAR)
static void clear_wifi_autocgcore(void)
{
	volatile uint32_t *const autocg1 =
		(volatile uint32_t *)NRF7120_WIFI_CLOCKGATECTRLAUTOCG1_ADDR;
	uint32_t before = *autocg1;

	*autocg1 = before & ~NRF7120_WIFI_AUTOCGCORE_MASK;
	__DSB();

#if defined(CONFIG_SERIAL)
	printk("Wi-Fi AUTOCGCORE cleared: before=0x%08x after=0x%08x\n", before, *autocg1);
#endif
}
#endif

#if defined(CONFIG_NRF7120_ROMDONE_SET)
static void set_romdone(void)
{
	volatile uint32_t *const romdone = (volatile uint32_t *)NRF7120_REGULATORS_ROMDONE_ADDR;

	*romdone = 1U;
	__DSB();

#if defined(CONFIG_SERIAL)
	printk("REGULATORS.ROM.ROMDONE set: 0x%08x\n", *romdone);
#endif
}
#endif

static void configure_ram(void)
{
#if defined(CONFIG_RAM_POWER_DOWN_LIBRARY)
	uintptr_t ram_start = DT_REG_ADDR(DT_CHOSEN(zephyr_sram));
	uintptr_t ram_end = ram_start + DT_REG_SIZE(DT_CHOSEN(zephyr_sram));

#if defined(CONFIG_SERIAL)
	printk("Keeping the first 128 KiB of application RAM powered\n");
#endif
	power_down_ram(ram_start + POWERED_RAM_SIZE, ram_end);
#elif defined(CONFIG_SERIAL)
	printk("No RAM power-down request\n");
#endif
}

#if defined(CONFIG_SERIAL)
static void run_timed_measurement(const struct device *console)
{
	int err;

	while (true) {
#if defined(CONFIG_NRF7120_PDSELECT_ACTIVE_CALIBRATION)
#if defined(CONFIG_NRF7120_IDLE_PHASE_MARKER)
		nrf_gpio_pin_set(NRF_GPIO_PIN_MAP(0, 0));
		nrf_gpio_cfg_output(NRF_GPIO_PIN_MAP(0, 0));
#endif
		printk("CPU active for 5 seconds\n");
		k_busy_wait(ACTIVE_TIME_US);
#endif

		printk("Entering System ON idle for 5 seconds\n");

#if defined(CONFIG_NRF7120_IDLE_DIAGNOSTICS)
		print_power_snapshot("pre-idle");
		nrf_power_event_clear(NRF_POWER, NRF_POWER_EVENT_SLEEPENTER);
#endif
#if defined(CONFIG_NRF7120_HVBUCK_EVENT_CLEAR)
		reg_write32(NRF7120_HVBUCK_EVENTS_LP2HP_ADDR, 0);
		reg_write32(NRF7120_HVBUCK_EVENTS_HP2LP_ADDR, 0);
		reg_write32(NRF7120_HVBUCK_EVENTS_HP2PWM_ADDR, 0);
		reg_write32(NRF7120_HVBUCK_EVENTS_PWM2HP_ADDR, 0);
		printk("post-clear: HV_EVT_LP2HP=%u HV_EVT_HP2LP=%u "
		       "HV_EVT_HP2PWM=%u HV_EVT_PWM2HP=%u\n",
		       reg_read32(NRF7120_HVBUCK_EVENTS_LP2HP_ADDR),
		       reg_read32(NRF7120_HVBUCK_EVENTS_HP2LP_ADDR),
		       reg_read32(NRF7120_HVBUCK_EVENTS_HP2PWM_ADDR),
		       reg_read32(NRF7120_HVBUCK_EVENTS_PWM2HP_ADDR));
#endif

#if defined(CONFIG_NRF7120_IDLE_PHASE_MARKER)
		/*
		 * Generate the falling edge, then disconnect the pad so the
		 * marker does not keep a GPIO output active during idle.
		 */
		nrf_gpio_pin_clear(NRF_GPIO_PIN_MAP(0, 0));
		nrf_gpio_cfg_default(NRF_GPIO_PIN_MAP(0, 0));
#endif

		err = pm_device_action_run(console, PM_DEVICE_ACTION_SUSPEND);
		if (err != 0) {
			printk("Failed to suspend console: %d\n", err);
			return;
		}

		k_sleep(IDLE_TIME);

		err = pm_device_action_run(console, PM_DEVICE_ACTION_RESUME);
		if (err != 0) {
			return;
		}

#if defined(CONFIG_NRF7120_IDLE_DIAGNOSTICS)
		printk("post-idle: SLEEPENTER=%u\n",
		       nrf_power_event_check(NRF_POWER, NRF_POWER_EVENT_SLEEPENTER));
		print_power_snapshot("post-idle");
#endif
		printk("Woke from System ON idle\n");
	}
}
#endif

#if defined(CONFIG_NRF7120_DIRECT_WFI)
static FUNC_NORETURN void enter_direct_wfi(void)
{
#if defined(CONFIG_NRF7120_DIRECT_WFI_MARKER)
	/*
	 * P0.00 is high only before the first WFI. If WFI returns, the code
	 * below clears P0.00 and spins forever without setting it again.
	 */
	nrf_gpio_pin_set(NRF_GPIO_PIN_MAP(0, 0));
	nrf_gpio_cfg_output(NRF_GPIO_PIN_MAP(0, 0));
#endif

	sys_clock_disable();
	__disable_irq();

	for (size_t i = 0; i < sizeof(NVIC->ICER) / sizeof(NVIC->ICER[0]); i++) {
		NVIC->ICER[i] = UINT32_MAX;
		NVIC->ICPR[i] = UINT32_MAX;
	}

	uint32_t icsr = SCB_ICSR_PENDSVCLR_Msk | SCB_ICSR_PENDSTCLR_Msk;

#ifdef SCB_ICSR_STTNS_Msk
	icsr |= SCB->ICSR & SCB_ICSR_STTNS_Msk;
#endif
	SCB->ICSR = icsr;
	__DSB();
	__ISB();

#if defined(CONFIG_NRF7120_DIRECT_WFI_MARKER)
	__WFI();
	nrf_gpio_pin_clear(NRF_GPIO_PIN_MAP(0, 0));

	while (true) {
		__NOP();
	}
#else
	while (true) {
		__WFI();
	}
#endif
}
#endif

int main(void)
{
#if defined(CONFIG_SERIAL)
	const struct device *const console = DEVICE_DT_GET(DT_CHOSEN(zephyr_console));

	if (!device_is_ready(console)) {
		return 0;
	}
#endif

	configure_ram();

#if defined(CONFIG_NRF7120_PDSELECT_DIAGNOSTICS)
	configure_pdselect();
#endif

#if defined(CONFIG_NRF7120_WIFI_AUTOCGCORE_CLEAR)
	clear_wifi_autocgcore();
#endif

#if defined(CONFIG_NRF7120_ROMDONE_SET)
	set_romdone();
#endif

#if defined(CONFIG_NRF7120_IDLE_PHASE_MARKER)
	nrf_gpio_cfg_default(NRF_GPIO_PIN_MAP(0, 0));
#endif

#if defined(CONFIG_NRF7120_FORCE_LOWPWR)
	nrf_power_task_trigger(NRF_POWER, NRF_POWER_TASK_LOWPWR);
#if defined(CONFIG_SERIAL)
	printk("POWER.TASKS_LOWPWR triggered\n");
#endif
#endif

#if defined(CONFIG_SERIAL)
	run_timed_measurement(console);
#endif

#if defined(CONFIG_NRF7120_DIRECT_WFI)
	enter_direct_wfi();
#endif

#if defined(CONFIG_NRF7120_SLEEP_FOREVER)
	k_sleep(K_FOREVER);
#endif

	return 0;
}
```
