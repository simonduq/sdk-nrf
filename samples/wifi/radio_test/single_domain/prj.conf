## CMakeLists.txt
```
#
# Copyright (c) 2024 Nordic Semiconductor ASA
#
# SPDX-License-Identifier: LicenseRef-Nordic-5-Clause
#

cmake_minimum_required(VERSION 3.20.0)

find_package(Zephyr REQUIRED HINTS $ENV{ZEPHYR_BASE})
project(wifi_ble_radio_test)

set(common_rt_dir ${ZEPHYR_NRF_MODULE_DIR}/samples/wifi/radio_test/common)
set(perip_rt_dir ${ZEPHYR_NRF_MODULE_DIR}/samples/peripheral/radio_test)

if(CONFIG_NRF71_RADIO_TEST)
  target_link_libraries(app PRIVATE nrf71_wifi_radio_test_headers)
endif()

target_include_directories(app PRIVATE ${common_rt_dir}/inc)

file(GLOB perip_rt_sources ${perip_rt_dir}/src/*.c)

# NORDIC SDK APP START
target_sources(app PRIVATE
  ${perip_rt_sources}
  ${common_rt_dir}/src/nrf_wifi_radio_test_shell.c
  src/measurement_modes.c
  src/system_off.c
  src/buttons.c
)

if(NOT CONFIG_NRF71_RADIO_TEST)
  target_sources(app PRIVATE
    ${common_rt_dir}/src/nrf_wifi_radio_ficr_shell.c
    ${common_rt_dir}/src/ficr_prog.c
  )

  target_link_libraries(app PRIVATE nrf-wifi-osal)
endif()
# NORDIC SDK APP END
```

## prj.conf
```kconfig
#
# Copyright (c) 2022 Nordic Semiconductor ASA
#
# SPDX-License-Identifier: LicenseRef-Nordic-5-Clause
#
CONFIG_WIFI=y

#CONFIG_INIT_STACKS=y

# Memories
CONFIG_MAIN_STACK_SIZE=5200
CONFIG_SHELL_STACK_SIZE=5200
#64K memory needed for IQ sample captures.
CONFIG_HEAP_MEM_POOL_SIZE=65536
CONFIG_NRF_WIFI_CTRL_HEAP_SIZE=32768
CONFIG_HEAP_MEM_POOL_IGNORE_MIN=y


# Debugging
CONFIG_STACK_SENTINEL=y
CONFIG_DEBUG_COREDUMP=y
CONFIG_DEBUG_COREDUMP_BACKEND_LOGGING=y
CONFIG_DEBUG_COREDUMP_MEMORY_DUMP_MIN=y
CONFIG_SHELL_CMDS_RESIZE=n
#CONFIG_DEBUG=y

# Logging
CONFIG_LOG=y
CONFIG_PRINTK=y
CONFIG_SHELL=y
CONFIG_SHELL_GETOPT=y
CONFIG_DEVICE_SHELL=y
CONFIG_POSIX_TIMERS=y
CONFIG_DATE_SHELL=y
CONFIG_LOG_BUFFER_SIZE=4096
CONFIG_SHELL_BACKEND_SERIAL_RX_RING_BUFFER_SIZE=1024

# Peripheral radio test configuration
CONFIG_CONSOLE_HANDLER=y
CONFIG_SHELL=y

CONFIG_DYNAMIC_INTERRUPTS=y

CONFIG_NRFX_TIMER=y
CONFIG_CLOCK_CONTROL=y

CONFIG_ENTROPY_GENERATOR=y
CONFIG_PSA_CRYPTO=y

CONFIG_FEM_AL_LIB=y
CONFIG_PICOLIBC_IO_FLOAT=y

# System OFF measurement mode, selected at runtime with the "systemoff" shell
# command. No wake-up source and no RAM retention are configured.
CONFIG_POWEROFF=y
CONFIG_REBOOT=y
CONFIG_PM_DEVICE=y
CONFIG_HWINFO=y
```

## boards/nrf7120dk_nrf7120_cpuapp_ns.conf
```kconfig
#
# Copyright (c) 2026 Nordic Semiconductor
#
# SPDX-License-Identifier: LicenseRef-Nordic-5-Clause
#

CONFIG_WIFI_NRF71=y
CONFIG_NRF71_RADIO_TEST=y

# Enable the necessary drivers
CONFIG_NRFX_TIMER=y
CONFIG_NRFX_GPPI=y

# Let the non-secure application enter System OFF through TF-M, as needed by
# the "systemoff" shell command.
CONFIG_TFM_SFN=y
CONFIG_TFM_NRF_SYSTEM_OFF_SERVICE=y
```

## src/buttons.c
```c
/*
 * Copyright (c) 2026 Nordic Semiconductor ASA
 *
 * SPDX-License-Identifier: LicenseRef-Nordic-5-Clause
 */

/** @file
 * @brief Front-panel button control for the unified power test firmware.
 *
 * Replaces the earlier persisted-marker auto-cycling of measurement modes
 * across reboots: sw0..sw3 now select a mode directly, at any time, without
 * a reset. The buttons themselves are described in devicetree ("gpio-keys",
 * see nrf7120dk_nrf7120-common.dtsi), pull-up and active-low included.
 *
 * Mapping:
 *   sw0  System OFF, on release (equivalent to the "systemoff" shell command)
 *   sw1  Wi-Fi Rx, on press    ("wifi_radio_test init 0 6" + "wifi_radio_test rx 1")
 *   sw2  Wi-Fi Tx, on press    ("wifi_radio_test init 0 6" + "wifi_radio_test tx_power 15"
 *                               + "wifi_radio_test tx 1")
 *   sw3  Stop, on press        ("wifi_radio_test rx 0" + "wifi_radio_test tx 0")
 *
 * sw0 triggers on release rather than press so that holding it down (e.g.
 * while inspecting the board) does not immediately power the device off.
 *
 * NOTE: on this engineering sample, GPIO port P4 (where sw0..sw3 and
 * led0..led3 live) has no GPIOTE instance wired up in the SoC devicetree
 * (see the gpio4 node in nrf7120_enga.dtsi, which is missing the
 * "gpiote-instance" property that gpio1/gpio3 have), so pin interrupts are
 * not available on this port. Buttons are therefore handled by polling the
 * raw pin state from a dedicated thread instead of via
 * gpio_add_callback()/ISR.
 */

#include <zephyr/device.h>
#include <zephyr/devicetree.h>
#include <zephyr/drivers/gpio.h>
#include <zephyr/kernel.h>
#include <zephyr/shell/shell.h>
#include <zephyr/shell/shell_uart.h>
#include <zephyr/sys/printk.h>

enum button_action {
	BUTTON_ACTION_SYSTEM_OFF,
	BUTTON_ACTION_RX,
	BUTTON_ACTION_TX,
	BUTTON_ACTION_STOP,
};

/* Edge to trigger the action on, in terms of the button's logical state
 * as returned by gpio_pin_get_dt() (1 = pressed, 0 = released).
 */
enum button_edge {
	BUTTON_EDGE_PRESS,
	BUTTON_EDGE_RELEASE,
};

struct button {
	struct gpio_dt_spec spec;
	enum button_action action;
	enum button_edge edge;
	const char *name;
	int last_state;
};

static struct button buttons[] = {
	{
		.spec = GPIO_DT_SPEC_GET(DT_ALIAS(sw0), gpios),
		.action = BUTTON_ACTION_SYSTEM_OFF,
		.edge = BUTTON_EDGE_RELEASE,
		.name = "sw0 (System OFF)",
		.last_state = INT32_MIN,
	},
	{
		.spec = GPIO_DT_SPEC_GET(DT_ALIAS(sw1), gpios),
		.action = BUTTON_ACTION_RX,
		.edge = BUTTON_EDGE_PRESS,
		.name = "sw1 (Wi-Fi Rx)",
		.last_state = INT32_MIN,
	},
	{
		.spec = GPIO_DT_SPEC_GET(DT_ALIAS(sw2), gpios),
		.action = BUTTON_ACTION_TX,
		.edge = BUTTON_EDGE_PRESS,
		.name = "sw2 (Wi-Fi Tx)",
		.last_state = INT32_MIN,
	},
	{
		.spec = GPIO_DT_SPEC_GET(DT_ALIAS(sw3), gpios),
		.action = BUTTON_ACTION_STOP,
		.edge = BUTTON_EDGE_PRESS,
		.name = "sw3 (Stop)",
		.last_state = INT32_MIN,
	},
};

static void button_action_run(struct button *button)
{
	const struct shell *sh = shell_backend_uart_get_ptr();
	int ret;

	printk("%s %s\n", button->name,
	       button->edge == BUTTON_EDGE_RELEASE ? "released" : "pressed");

	switch (button->action) {
	case BUTTON_ACTION_SYSTEM_OFF:
		ret = shell_execute_cmd(sh, "systemoff");
		break;
	case BUTTON_ACTION_RX:
		ret = shell_execute_cmd(sh, "wifi_radio_test init 0 6");
		ret = ret ? ret : shell_execute_cmd(sh, "wifi_radio_test rx 1");
		break;
	case BUTTON_ACTION_TX:
		ret = shell_execute_cmd(sh, "wifi_radio_test init 0 6");
		ret = ret ? ret : shell_execute_cmd(sh, "wifi_radio_test tx_power 15");
		ret = ret ? ret : shell_execute_cmd(sh, "wifi_radio_test tx 1");
		break;
	case BUTTON_ACTION_STOP:
		ret = shell_execute_cmd(sh, "wifi_radio_test rx 0");
		ret = ret ? ret : shell_execute_cmd(sh, "wifi_radio_test tx 0");
		break;
	default:
		ret = -EINVAL;
		break;
	}

	if (ret != 0) {
		printk("%s: command failed (%d)\n", button->name, ret);
	}
}

static void button_poll_thread(void *p1, void *p2, void *p3)
{
	ARG_UNUSED(p1);
	ARG_UNUSED(p2);
	ARG_UNUSED(p3);

	for (size_t i = 0; i < ARRAY_SIZE(buttons); i++) {
		struct button *button = &buttons[i];

		if (!gpio_is_ready_dt(&button->spec)) {
			printk("%s: device not ready\n", button->name);
			continue;
		}

		if (gpio_pin_configure_dt(&button->spec, GPIO_INPUT) != 0) {
			printk("%s: failed to configure\n", button->name);
		}
	}

	while (1) {
		for (size_t i = 0; i < ARRAY_SIZE(buttons); i++) {
			struct button *button = &buttons[i];
			int val;

			if (!gpio_is_ready_dt(&button->spec)) {
				continue;
			}

			val = gpio_pin_get_dt(&button->spec);
			if (val < 0) {
				continue;
			}

			if (val != button->last_state &&
			    button->last_state != INT32_MIN) {
				bool pressed = (val == 1);
				bool trigger = (button->edge == BUTTON_EDGE_PRESS) ?
					       pressed : !pressed;

				if (trigger) {
					button_action_run(button);
				}
			}

			button->last_state = val;
		}

		k_msleep(20);
	}
}

K_THREAD_DEFINE(button_poll, 1024, button_poll_thread, NULL, NULL, NULL, 7, 0, 0);
```

## src/measurement_modes.c
```c
/*
 * Copyright (c) 2026 Nordic Semiconductor ASA
 *
 * SPDX-License-Identifier: LicenseRef-Nordic-5-Clause
 */

/** @file
 * @brief Measurement mode shorthands for the unified power test firmware.
 *
 * The Wi-Fi Rx and Wi-Fi Tx current measurements each need a fixed sequence of
 * radio test commands. The "rx" and "tx" shorthands run those sequences, and
 * echo each command as it runs so that the shell log still shows exactly what
 * was configured. The third mode, System OFF, is the "off" command implemented
 * in system_off.c.
 *
 * The sequences are executed by a worker thread rather than directly from the
 * command handler, because shell_execute_cmd() must not be called from command
 * context: it reuses the shell command buffer and takes the shell transport
 * lock, both of which are busy while a command handler runs.
 */

#include <zephyr/init.h>
#include <zephyr/kernel.h>
#include <zephyr/shell/shell.h>
#include <zephyr/sys/atomic.h>
#include <zephyr/sys/printk.h>
#include <zephyr/sys/util.h>

#if defined(CONFIG_SOC_SERIES_NRF71)
/* FICR->PROTEST.CP.TIMESTAMP1, not exposed by the FICR devicetree node. */
#define FICR_PROTEST_CP_TIMESTAMP1_ADDR 0x00FFC3CCUL
#endif

/* The worker runs at the shell thread priority, and the shell thread only
 * yields once it has finished the command and is waiting for input again. The
 * radio test command handlers run on this stack, so size it like the shell's.
 */
#define MODE_THREAD_STACK_SIZE CONFIG_SHELL_STACK_SIZE
#define MODE_THREAD_PRIORITY   K_LOWEST_APPLICATION_THREAD_PRIO

/* Extra margin on top of the priority argument above, in case the shell is
 * preempted between returning from the handler and releasing its lock.
 */
#define MODE_START_DELAY K_MSEC(20)

/* Wi-Fi Rx at 2.4 GHz, channel 6. */
static const char *const rx_mode_cmds[] = {
	"wifi_radio_test init 0 6",
	"wifi_radio_test rx 1",
};

/* Wi-Fi Tx at 2.4 GHz, channel 6, 15 dBm, modulated frames back-to-back. */
static const char *const tx_mode_cmds[] = {
	"wifi_radio_test init 0 6",
	"wifi_radio_test tx_power 15",
	"wifi_radio_test tx 1",
};

struct measurement_mode {
	const char *name;
	const char *const *cmds;
	size_t cmd_count;
};

static const struct measurement_mode rx_mode = {
	.name = "Wi-Fi Rx",
	.cmds = rx_mode_cmds,
	.cmd_count = ARRAY_SIZE(rx_mode_cmds),
};

static const struct measurement_mode tx_mode = {
	.name = "Wi-Fi Tx",
	.cmds = tx_mode_cmds,
	.cmd_count = ARRAY_SIZE(tx_mode_cmds),
};

static const struct measurement_mode *requested_mode;
static const struct shell *requesting_shell;
static atomic_t mode_busy;
static K_SEM_DEFINE(mode_request, 0, 1);

static void measurement_mode_run(void *unused1, void *unused2, void *unused3)
{
	ARG_UNUSED(unused1);
	ARG_UNUSED(unused2);
	ARG_UNUSED(unused3);

	while (true) {
		const struct measurement_mode *mode;
		const struct shell *sh;
		int err = 0;

		k_sem_take(&mode_request, K_FOREVER);

		mode = requested_mode;
		sh = requesting_shell;

		k_sleep(MODE_START_DELAY);

		for (size_t i = 0; i < mode->cmd_count; i++) {
			shell_print(sh, "> %s", mode->cmds[i]);

			err = shell_execute_cmd(sh, mode->cmds[i]);
			if (err) {
				shell_error(sh, "%s mode aborted: \"%s\" failed (%d)",
					    mode->name, mode->cmds[i], err);
				break;
			}
		}

		if (!err) {
			shell_print(sh, "%s mode running. Capture the current now.",
				    mode->name);
		}

		atomic_clear(&mode_busy);
	}
}

K_THREAD_DEFINE(measurement_mode_thread, MODE_THREAD_STACK_SIZE,
		measurement_mode_run, NULL, NULL, NULL,
		MODE_THREAD_PRIORITY, 0, 0);

static int measurement_mode_request(const struct shell *sh,
				    const struct measurement_mode *mode)
{
	if (atomic_set(&mode_busy, 1)) {
		shell_error(sh, "A measurement mode is still starting up, try again");
		return -EBUSY;
	}

	requested_mode = mode;
	requesting_shell = sh;

	k_sem_give(&mode_request);

	return 0;
}

static int cmd_rx_mode(const struct shell *sh, size_t argc, char *argv[])
{
	ARG_UNUSED(argc);
	ARG_UNUSED(argv);

	return measurement_mode_request(sh, &rx_mode);
}

static int cmd_tx_mode(const struct shell *sh, size_t argc, char *argv[])
{
	ARG_UNUSED(argc);
	ARG_UNUSED(argv);

	return measurement_mode_request(sh, &tx_mode);
}

SHELL_CMD_REGISTER(rx, NULL,
		   "Start the Wi-Fi Rx current measurement mode.\n"
		   "Receives on channel 6 in the 2.4 GHz band, by running:\n"
		   "  wifi_radio_test init 0 6\n"
		   "  wifi_radio_test rx 1",
		   cmd_rx_mode);

SHELL_CMD_REGISTER(tx, NULL,
		   "Start the Wi-Fi Tx current measurement mode.\n"
		   "Transmits modulated frames back-to-back on channel 6 in the\n"
		   "2.4 GHz band at 15 dBm, by running:\n"
		   "  wifi_radio_test init 0 6\n"
		   "  wifi_radio_test tx_power 15\n"
		   "  wifi_radio_test tx 1",
		   cmd_tx_mode);

static int measurement_modes_banner(void)
{
#if defined(CONFIG_SOC_SERIES_NRF71)
	printk("FICR->PROTEST.CP.TIMESTAMP1 (0x%08lX) = 0x%08x\n",
	       FICR_PROTEST_CP_TIMESTAMP1_ADDR,
	       *(volatile uint32_t *)FICR_PROTEST_CP_TIMESTAMP1_ADDR);
#endif

	printk("\n"
	       "Unified power test firmware. One command per measurement mode:\n"
	       "  rx    Wi-Fi Rx current, 2.4 GHz channel 6\n"
	       "  tx    Wi-Fi Tx current, 2.4 GHz channel 6, 15 dBm\n"
	       "  off   System OFF current, the lowest power mode\n"
	       "\n"
	       "\"rx\" and \"tx\" echo the wifi_radio_test commands they run, so the\n"
	       "individual commands remain available. \"off\" resets first and enters\n"
	       "System OFF before anything is initialized; recover the device with\n"
	       "\"west flash --recover\". Run \"<command> -h\" for details.\n"
	       "\n");

	return 0;
}

/* Runs after the radio test shell initialization, which is registered at the
 * APPLICATION level with CONFIG_APPLICATION_INIT_PRIORITY.
 */
SYS_INIT(measurement_modes_banner, APPLICATION, 99);
```

## src/system_off.c
```c
/*
 * Copyright (c) 2026 Nordic Semiconductor ASA
 *
 * SPDX-License-Identifier: LicenseRef-Nordic-5-Clause
 */

/** @file
 * @brief Runtime-selectable System OFF mode for the unified power test firmware.
 *
 * The radio test sample and the Zephyr system_off sample normally select their
 * behavior at build time. This file adds a "systemoff" shell command so that a
 * single image can be used for Wi-Fi Rx, Wi-Fi Tx and System OFF current
 * measurements, without rebuilding.
 *
 * Two entry paths are provided:
 *
 * - "off" (or "systemoff"): request System OFF and warm reset. The request is
 *   kept in uninitialized RAM, which survives a software reset, and is acted
 *   upon at the very first initialization step of the next boot. Nothing is
 *   running at that point: no console, no shell, no logging, no system clock
 *   and no Wi-Fi driver. This reproduces the conditions of the
 *   "No Wakeup Configured, No Ram Retention, Sysclock is disabled" build of the
 *   system_off sample.
 *
 * - "off now": tear down the running firmware (radio test, shell,
 *   logging, console, system clock) and enter System OFF in place. Use it when
 *   a warm reset is not wanted; the residual current may be slightly higher
 *   because peripherals brought up by this boot are only shut down by software.
 *
 * No wake-up source is configured and no RAM retention is requested in either
 * path, so the only way out of System OFF is a pin reset or a power cycle.
 */

#include <string.h>

#include <zephyr/device.h>
#include <zephyr/devicetree.h>
#include <zephyr/drivers/hwinfo.h>
#include <zephyr/drivers/timer/system_timer.h>
#include <zephyr/init.h>
#include <zephyr/kernel.h>
#include <zephyr/logging/log_backend.h>
#include <zephyr/logging/log_ctrl.h>
#include <zephyr/pm/device.h>
#include <zephyr/shell/shell.h>
#include <zephyr/sys/poweroff.h>
#include <zephyr/sys/reboot.h>
#include <zephyr/toolchain.h>

#if defined(CONFIG_NRF71_RADIO_TEST)
#include <radio_test/main.h>
#include <radio_test/fmac_api.h>
#endif

/* Kept out of the initialized data sections on purpose: the value has to
 * survive the warm reset triggered by the "systemoff" command.
 */
#define SYSTEM_OFF_REQUEST_MAGIC 0x5ff0ff5aUL

static __noinit uint32_t system_off_request;

/* Time given to the console to drain the last messages before it is suspended
 * or the device is reset.
 */
#define CONSOLE_DRAIN_TIME K_MSEC(100)

static void system_off_enter(bool stop_system_clock)
{
	/* z_sys_poweroff() only clears the reset reason on the nRF54L Series,
	 * so do it here to keep the reset cause reported after wake-up clean.
	 */
	(void)hwinfo_clear_reset_cause();

	if (stop_system_clock) {
		/* Stop the system clock, and with it the GRTC, so that nothing
		 * is left running in System OFF.
		 */
		sys_clock_disable();
	}

	sys_poweroff();

	CODE_UNREACHABLE;
}

/* Runs before any other initialization step, including the system clock
 * driver (registered at EARLY, priority 1), the console and the Wi-Fi driver.
 */
static int system_off_early_entry(void)
{
	if (system_off_request != SYSTEM_OFF_REQUEST_MAGIC) {
		/* Not a System OFF request: make sure a random RAM pattern is
		 * not mistaken for one on a later boot.
		 */
		system_off_request = 0;
		return 0;
	}

	/* Clear the request first: waking up from System OFF is a cold boot,
	 * but a pin reset that happens before this point must not enter
	 * System OFF again.
	 */
	system_off_request = 0;

	/* The system clock driver has not run yet, so the GRTC and the LFCLK
	 * were never started and must not be released here.
	 */
	system_off_enter(false);

	return 0;
}

SYS_INIT(system_off_early_entry, EARLY, 0);

static void logging_stop(void)
{
	/* Flush whatever is pending, then take the backends down so that no
	 * late log message can wake the console up again.
	 */
	log_panic();

	for (int i = 0; i < log_backend_count_get(); i++) {
		const struct log_backend *backend = log_backend_get(i);

		if (log_backend_is_active(backend)) {
			log_backend_disable(backend);
		}
	}
}

#if defined(CONFIG_NRF71_RADIO_TEST)
static void radio_test_stop(const struct shell *sh)
{
	struct nrf_wifi_rt_drv_ctx *rt_ctx = &rt_drv_priv.drv_ctx;

	if (rt_ctx->rpu_ctx == NULL) {
		return;
	}

	/* Stop an ongoing transmission or reception, so that the radio is not
	 * left running while the rest of the firmware is shut down.
	 */
	if (rt_ctx->conf_params.tx) {
		rt_ctx->conf_params.tx = 0;

		if (nrf_wifi_rt_fmac_prog_tx(rt_ctx->rpu_ctx, &rt_ctx->conf_params) !=
		    NRF_WIFI_STATUS_SUCCESS) {
			shell_warn(sh, "Failed to stop the ongoing transmission");
		}
	}

	if (rt_ctx->conf_params.rx) {
		rt_ctx->conf_params.rx = 0;

		if (nrf_wifi_rt_fmac_prog_rx(rt_ctx->rpu_ctx, &rt_ctx->conf_params) !=
		    NRF_WIFI_STATUS_SUCCESS) {
			shell_warn(sh, "Failed to stop the ongoing reception");
		}
	}
}
#else
static void radio_test_stop(const struct shell *sh)
{
	ARG_UNUSED(sh);
}
#endif /* defined(CONFIG_NRF71_RADIO_TEST) */

static int system_off_in_place(const struct shell *sh)
{
	const struct device *const cons = DEVICE_DT_GET(DT_CHOSEN(zephyr_console));

	radio_test_stop(sh);

	shell_print(sh, "Entering System OFF in place. Reset the board to wake up.");
	k_sleep(CONSOLE_DRAIN_TIME);

	/* Kill the shell: it stops processing input and stops printing, and
	 * its logging backend is disabled.
	 */
	(void)shell_stop(sh);

	logging_stop();

	/* Suspending the console disables the UART peripheral and releases its
	 * pins. There is nobody left to report a failure to, and a failure only
	 * costs current, so the result is ignored.
	 */
	if (device_is_ready(cons)) {
		(void)pm_device_action_run(cons, PM_DEVICE_ACTION_SUSPEND);
	}

	system_off_enter(true);

	return 0;
}

static int system_off_after_reset(const struct shell *sh)
{
	radio_test_stop(sh);

	shell_print(sh, "Entering System OFF after reset. Reset the board to wake up.");
	k_sleep(CONSOLE_DRAIN_TIME);

	system_off_request = SYSTEM_OFF_REQUEST_MAGIC;

	sys_reboot(SYS_REBOOT_COLD);

	return 0;
}

static int cmd_system_off(const struct shell *sh, size_t argc, char *argv[])
{
	if (argc > 1) {
		if (strcmp(argv[1], "-h") == 0 || strcmp(argv[1], "--help") == 0) {
			shell_help(sh);
			return SHELL_CMD_HELP_PRINTED;
		}

		if (strcmp(argv[1], "now") != 0) {
			shell_error(sh, "Unknown argument \"%s\"", argv[1]);
			shell_help(sh);
			return -EINVAL;
		}

		return system_off_in_place(sh);
	}

	return system_off_after_reset(sh);
}

/* The command is registered twice: "off" is the shorthand used alongside the
 * "rx" and "tx" measurement modes, "systemoff" is kept as the explicit name.
 */
#define SYSTEM_OFF_CMD_HELP \
	"Start the System OFF current measurement mode, the lowest power mode.\n" \
	"Resets first, then enters System OFF as the very first initialization\n" \
	"step, before the console, shell, logging, system clock and Wi-Fi driver\n" \
	"are brought up. No wake-up source and no RAM retention are configured,\n" \
	"so nothing wakes the device: recover it with \"west flash --recover\".\n" \
	"Usage: off|systemoff [now]\n" \
	"  (no argument)  Reset first, then enter System OFF. Lowest current.\n" \
	"  now            Enter System OFF in place, without resetting: stops\n" \
	"                 Wi-Fi Tx/Rx, the shell, logging and the console. Use it\n" \
	"                 to measure from a state the radio test set up; the\n" \
	"                 current can be slightly higher."

SHELL_CMD_ARG_REGISTER(off, NULL, SYSTEM_OFF_CMD_HELP, cmd_system_off, 1, 1);

SHELL_CMD_ARG_REGISTER(systemoff, NULL, SYSTEM_OFF_CMD_HELP, cmd_system_off, 1, 1);
```
